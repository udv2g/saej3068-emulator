variables                                                                        
{                                                                                
  char EV_Info_Codes[256][38] = {       "Depricated_Unspecified",                // 0       
                                        "Depricated_StStatusOp_not_ready",       // 1       
                                        "Depricated_EV_Energy_Management_Fault", // 2       
                                        "Depricated_User_Stop",                  // 3       
                                        "Depricated_Maximum_current_too_low",    // 4       
                                        "Reserved",                              // 5       
                                        "Reserved",                              // 6       
                                        "Reserved",                              // 7       
                                        "Reserved",                              // 8       
                                        "Reserved",                              // 9       
                                        "Reserved",                              // A       
                                        "Reserved",                              // B       
                                        "Reserved",                              // C       
                                        "Reserved",                              // D       
                                        "Reserved",                              // E       
                                        "Reserved",                              // F       
                                        "Reserved",                              // 10      
                                        "Version_fails",                         // 11      
                                        "Initialization_fails",                  // 12      
                                        "Version_Restart",                       // 13      
                                        "Bit_Rate_Restart",                      // 14      
                                        "MCU_Reset_Restart",                     // 15      
                                        "Pilot_Fault_Restart",                   // 16      
                                        "No_LIN",                                // 17      
                                        "Int_Fault_Restart",                     // 18      
                                        "Int_Fault_Termination",                 // 19      
                                        "Available_current_too_low",             // 1A      
                                        "Available_voltage_too_high",            // 1B      
                                        "Frequency_Mismatch",                    // 1C      
                                        "EMS_Charging_delayed",                  // 1D      
                                        "Isolation_fault",                       // 1E      
                                        "Charging_Delayed",                      // 1F      
                                        "Interrupt_Clean",                       // 20      
                                        "Interrupt_Dirty",                       // 21      
                                        "Available_voltage_too_low",             // 22      
                                        "Latch_or_lock_failure",                 // 23      
                                        "Paging_error",                          // 24      
                                        "EvMinCurrentX_required",                // 25      
                                        "Charging_complete",                     // 26      
                                        "Charging_temporarily_prevented",        // 27      
                                        "Charging_fatally_prevented",            // 28      
                                        "Connection_incompatible",               // 29      
                                        "Charging_delayed_for_ID",               // 2A      
                                        "Charging_disallowed_for_ID",            // 2B      
                                        "Proximity_Power_Requested",             // 2C      
                                        "Reserved",                              // 2D      
                                        "Reserved",                              // 2E      
                                        "Reserved",                              // 2F      
                                        "Reserved",                              // 30      
                                        "Reserved",                              // 31      
                                        "Reserved",                              // 32      
                                        "Reserved",                              // 33      
                                        "Reserved",                              // 34      
                                        "Reserved",                              // 35      
                                        "Reserved",                              // 36      
                                        "Reserved",                              // 37      
                                        "Reserved",                              // 38      
                                        "Reserved",                              // 39      
                                        "Reserved",                              // 3A      
                                        "Reserved",                              // 3B      
                                        "Reserved",                              // 3C      
                                        "Reserved",                              // 3D      
                                        "Reserved",                              // 3E      
                                        "Reserved",                              // 3F      
                                        "Reserved",                              // 40      
                                        "Reserved",                              // 41      
                                        "Reserved",                              // 42      
                                        "Reserved",                              // 43      
                                        "Reserved",                              // 44      
                                        "Reserved",                              // 45      
                                        "Reserved",                              // 46      
                                        "Reserved",                              // 47      
                                        "Reserved",                              // 48      
                                        "Reserved",                              // 49      
                                        "Reserved",                              // 4A      
                                        "Reserved",                              // 4B      
                                        "Reserved",                              // 4C      
                                        "Reserved",                              // 4D      
                                        "Reserved",                              // 4E      
                                        "Reserved",                              // 4F      
                                        "Reserved",                              // 50      
                                        "Reserved",                              // 51      
                                        "Reserved",                              // 52      
                                        "Reserved",                              // 53      
                                        "Reserved",                              // 54      
                                        "Reserved",                              // 55      
                                        "Reserved",                              // 56      
                                        "Reserved",                              // 57      
                                        "Reserved",                              // 58      
                                        "Reserved",                              // 59      
                                        "Reserved",                              // 5A      
                                        "Reserved",                              // 5B      
                                        "Reserved",                              // 5C      
                                        "Reserved",                              // 5D      
                                        "Reserved",                              // 5E      
                                        "Reserved",                              // 5F      
                                        "Reserved",                              // 60      
                                        "Reserved",                              // 61      
                                        "Reserved",                              // 62      
                                        "Reserved",                              // 63      
                                        "Reserved",                              // 64      
                                        "Reserved",                              // 65      
                                        "Reserved",                              // 66      
                                        "Reserved",                              // 67      
                                        "Reserved",                              // 68      
                                        "Reserved",                              // 69      
                                        "Reserved",                              // 6A      
                                        "Reserved",                              // 6B      
                                        "Reserved",                              // 6C      
                                        "Reserved",                              // 6D      
                                        "Reserved",                              // 6E      
                                        "Reserved",                              // 6F      
                                        "Reserved",                              // 70      
                                        "Reserved",                              // 71      
                                        "Reserved",                              // 72      
                                        "Reserved",                              // 73      
                                        "Reserved",                              // 74      
                                        "Reserved",                              // 75      
                                        "Reserved",                              // 76      
                                        "Reserved",                              // 77      
                                        "Reserved",                              // 78      
                                        "Reserved",                              // 79      
                                        "Reserved",                              // 7A      
                                        "Reserved",                              // 7B      
                                        "Reserved",                              // 7C      
                                        "Reserved",                              // 7D      
                                        "Reserved",                              // 7E      
                                        "Reserved",                              // 7F      
                                        "Reserved",                              // 80      
                                        "Reserved",                              // 81      
                                        "Reserved",                              // 82      
                                        "Reserved",                              // 83      
                                        "Reserved",                              // 84      
                                        "Reserved",                              // 85      
                                        "Reserved",                              // 86      
                                        "Reserved",                              // 87      
                                        "Reserved",                              // 88      
                                        "Reserved",                              // 89      
                                        "Reserved",                              // 8A      
                                        "Reserved",                              // 8B      
                                        "Reserved",                              // 8C      
                                        "Reserved",                              // 8D      
                                        "Reserved",                              // 8E      
                                        "Reserved",                              // 8F      
                                        "Reserved",                              // 90      
                                        "Reserved",                              // 91      
                                        "Reserved",                              // 92      
                                        "Reserved",                              // 93      
                                        "Reserved",                              // 94      
                                        "Reserved",                              // 95      
                                        "Reserved",                              // 96      
                                        "Reserved",                              // 97      
                                        "Reserved",                              // 98      
                                        "Reserved",                              // 99      
                                        "Reserved",                              // 9A      
                                        "Reserved",                              // 9B      
                                        "Reserved",                              // 9C      
                                        "Reserved",                              // 9D      
                                        "Reserved",                              // 9E      
                                        "Reserved",                              // 9F      
                                        "Reserved",                              // A0      
                                        "Reserved",                              // A1      
                                        "Reserved",                              // A2      
                                        "Reserved",                              // A3      
                                        "Reserved",                              // A4      
                                        "Reserved",                              // A5      
                                        "Reserved",                              // A6      
                                        "Reserved",                              // A7      
                                        "Reserved",                              // A8      
                                        "Reserved",                              // A9      
                                        "Reserved",                              // AA      
                                        "Reserved",                              // AB      
                                        "Reserved",                              // AC      
                                        "Reserved",                              // AD      
                                        "Reserved",                              // AE      
                                        "Reserved",                              // AF      
                                        "Reserved",                              // B0      
                                        "Reserved",                              // B1      
                                        "Reserved",                              // B2      
                                        "Reserved",                              // B3      
                                        "Reserved",                              // B4      
                                        "Reserved",                              // B5      
                                        "Reserved",                              // B6      
                                        "Reserved",                              // B7      
                                        "Reserved",                              // B8      
                                        "Reserved",                              // B9      
                                        "Reserved",                              // BA      
                                        "Reserved",                              // BB      
                                        "Reserved",                              // BC      
                                        "Reserved",                              // BD      
                                        "Reserved",                              // BE      
                                        "Reserved",                              // BF      
                                        "Reserved",                              // C0      
                                        "Reserved",                              // C1      
                                        "Reserved",                              // C2      
                                        "Reserved",                              // C3      
                                        "Reserved",                              // C4      
                                        "Reserved",                              // C5      
                                        "Reserved",                              // C6      
                                        "Reserved",                              // C7      
                                        "Reserved",                              // C8      
                                        "Reserved",                              // C9      
                                        "Reserved",                              // CA      
                                        "Reserved",                              // CB      
                                        "Reserved",                              // CC      
                                        "Reserved",                              // CD      
                                        "Reserved",                              // CE      
                                        "Reserved",                              // CF      
                                        "Reserved",                              // D0      
                                        "Reserved",                              // D1      
                                        "Reserved",                              // D2      
                                        "Reserved",                              // D3      
                                        "Reserved",                              // D4      
                                        "Reserved",                              // D5      
                                        "Reserved",                              // D6      
                                        "Reserved",                              // D7      
                                        "Reserved",                              // D8      
                                        "Reserved",                              // D9      
                                        "Reserved",                              // DA      
                                        "Reserved",                              // DB      
                                        "Reserved",                              // DC      
                                        "Reserved",                              // DD      
                                        "Reserved",                              // DE      
                                        "Reserved",                              // DF      
                                        "Manufacturer_Specific",                 // E0      
                                        "Manufacturer_Specific",                 // E1      
                                        "Manufacturer_Specific",                 // E2      
                                        "Manufacturer_Specific",                 // E3      
                                        "Manufacturer_Specific",                 // E4      
                                        "Manufacturer_Specific",                 // E5      
                                        "Manufacturer_Specific",                 // E6      
                                        "Manufacturer_Specific",                 // E7      
                                        "Manufacturer_Specific",                 // E8      
                                        "Manufacturer_Specific",                 // E9      
                                        "Manufacturer_Specific",                 // EA      
                                        "Manufacturer_Specific",                 // EB      
                                        "Manufacturer_Specific",                 // EC      
                                        "Manufacturer_Specific",                 // ED      
                                        "Manufacturer_Specific",                 // EE      
                                        "Manufacturer_Specific",                 // EF      
                                        "Manufacturer_Specific",                 // F0      
                                        "Manufacturer_Specific",                 // F1      
                                        "Manufacturer_Specific",                 // F2      
                                        "Manufacturer_Specific",                 // F3      
                                        "Manufacturer_Specific",                 // F4      
                                        "Manufacturer_Specific",                 // F5      
                                        "Manufacturer_Specific",                 // F6      
                                        "Manufacturer_Specific",                 // F7      
                                        "Manufacturer_Specific",                 // F8      
                                        "Manufacturer_Specific",                 // F9      
                                        "Manufacturer_Specific",                 // FA      
                                        "Manufacturer_Specific",                 // FB      
                                        "Manufacturer_Specific",                 // FC      
                                        "Manufacturer_Specific",                 // FD      
                                        "Manufacturer_Specific",                 // FE      
                                        "Empty"                                  // FF      
                                        };                                       
  char SE_Info_Codes[256][30] = {       "Depricated_Unspecified",                // 0       
                                        "Depricated_sleep",                      // 1       
                                        "Depricated_Energy_Unavailable",         // 2       
                                        "Depricated_User_Stop",                  // 3       
                                        "Reserved",                              // 4       
                                        "Reserved",                              // 5       
                                        "Reserved",                              // 6       
                                        "Reserved",                              // 7       
                                        "Reserved",                              // 8       
                                        "Reserved",                              // 9       
                                        "Reserved",                              // A       
                                        "Reserved",                              // B       
                                        "Reserved",                              // C       
                                        "Reserved",                              // D       
                                        "Reserved",                              // E       
                                        "Reserved",                              // F       
                                        "Reserved",                              // 10      
                                        "Version_fails",                         // 11      
                                        "Initialization_fails",                  // 12      
                                        "Version_Restart",                       // 13      
                                        "Bit_Rate_Restart",                      // 14      
                                        "MCU_Reset_Restart",                     // 15      
                                        "Power_Fault_Restart",                   // 16      
                                        "No_LIN",                                // 17      
                                        "Int_Fault_Restart",                     // 18      
                                        "EMS_Charging_delayed",                  // 19      
                                        "User_Stop",                             // 1A      
                                        "Available_current_too_low",             // 1B      
                                        "Available_voltage_too_high",            // 1C      
                                        "Frequency_Mismatch",                    // 1D      
                                        "Init_timeout",                          // 1E      
                                        "Connector_Over_Temp",                   // 1F      
                                        "Over_Temp",                             // 20      
                                        "Temp_Sense_Invalid",                    // 21      
                                        "Overcurrent",                           // 22      
                                        "Current_Sense_Invalid",                 // 23      
                                        "Voltage_Sense_Invalid",                 // 24      
                                        "Pilot_fault",                           // 25      
                                        "Contactor_fault",                       // 26      
                                        "Input_miswired",                        // 27      
                                        "Input_over_voltage",                    // 28      
                                        "Input_under_voltage",                   // 29      
                                        "CCID_self_test_fault",                  // 2A      
                                        "CCID_tripped_retry",                    // 2B      
                                        "CCID_tripped_no_retry",                 // 2C      
                                        "Breaker_tripped",                       // 2D      
                                        "Ground_Monitor_fault",                  // 2E      
                                        "Configuration_error",                   // 2F      
                                        "Ground_fault",                          // 30      
                                        "Comm_Fault",                            // 31      
                                        "Internal_Fault",                        // 32      
                                        "Available_voltage_too_low",             // 33      
                                        "Paging_error",                          // 34      
                                        "Connection_incompatible",               // 35      
                                        "Charging_delayed_for_ID",               // 36      
                                        "Charging_delayed_for_payment",          // 37      
                                        "Charging_disallowed_for_ID",            // 38      
                                        "Req_impossible_Max_charge",             // 39      
                                        "Unlock_requested",                      // 3A      
                                        "Proximity_Power_Requested",             // 3B      
                                        "Reserved",                              // 3C      
                                        "Reserved",                              // 3D      
                                        "Reserved",                              // 3E      
                                        "Reserved",                              // 3F      
                                        "Reserved",                              // 40      
                                        "Reserved",                              // 41      
                                        "Reserved",                              // 42      
                                        "Reserved",                              // 43      
                                        "Reserved",                              // 44      
                                        "Reserved",                              // 45      
                                        "Reserved",                              // 46      
                                        "Reserved",                              // 47      
                                        "Reserved",                              // 48      
                                        "Reserved",                              // 49      
                                        "Reserved",                              // 4A      
                                        "Reserved",                              // 4B      
                                        "Reserved",                              // 4C      
                                        "Reserved",                              // 4D      
                                        "Reserved",                              // 4E      
                                        "Reserved",                              // 4F      
                                        "Reserved",                              // 50      
                                        "Reserved",                              // 51      
                                        "Reserved",                              // 52      
                                        "Reserved",                              // 53      
                                        "Reserved",                              // 54      
                                        "Reserved",                              // 55      
                                        "Reserved",                              // 56      
                                        "Reserved",                              // 57      
                                        "Reserved",                              // 58      
                                        "Reserved",                              // 59      
                                        "Reserved",                              // 5A      
                                        "Reserved",                              // 5B      
                                        "Reserved",                              // 5C      
                                        "Reserved",                              // 5D      
                                        "Reserved",                              // 5E      
                                        "Reserved",                              // 5F      
                                        "Reserved",                              // 60      
                                        "Reserved",                              // 61      
                                        "Reserved",                              // 62      
                                        "Reserved",                              // 63      
                                        "Reserved",                              // 64      
                                        "Reserved",                              // 65      
                                        "Reserved",                              // 66      
                                        "Reserved",                              // 67      
                                        "Reserved",                              // 68      
                                        "Reserved",                              // 69      
                                        "Reserved",                              // 6A      
                                        "Reserved",                              // 6B      
                                        "Reserved",                              // 6C      
                                        "Reserved",                              // 6D      
                                        "Reserved",                              // 6E      
                                        "Reserved",                              // 6F      
                                        "Reserved",                              // 70      
                                        "Reserved",                              // 71      
                                        "Reserved",                              // 72      
                                        "Reserved",                              // 73      
                                        "Reserved",                              // 74      
                                        "Reserved",                              // 75      
                                        "Reserved",                              // 76      
                                        "Reserved",                              // 77      
                                        "Reserved",                              // 78      
                                        "Reserved",                              // 79      
                                        "Reserved",                              // 7A      
                                        "Reserved",                              // 7B      
                                        "Reserved",                              // 7C      
                                        "Reserved",                              // 7D      
                                        "Reserved",                              // 7E      
                                        "Reserved",                              // 7F      
                                        "Reserved",                              // 80      
                                        "Reserved",                              // 81      
                                        "Reserved",                              // 82      
                                        "Reserved",                              // 83      
                                        "Reserved",                              // 84      
                                        "Reserved",                              // 85      
                                        "Reserved",                              // 86      
                                        "Reserved",                              // 87      
                                        "Reserved",                              // 88      
                                        "Reserved",                              // 89      
                                        "Reserved",                              // 8A      
                                        "Reserved",                              // 8B      
                                        "Reserved",                              // 8C      
                                        "Reserved",                              // 8D      
                                        "Reserved",                              // 8E      
                                        "Reserved",                              // 8F      
                                        "Reserved",                              // 90      
                                        "Reserved",                              // 91      
                                        "Reserved",                              // 92      
                                        "Reserved",                              // 93      
                                        "Reserved",                              // 94      
                                        "Reserved",                              // 95      
                                        "Reserved",                              // 96      
                                        "Reserved",                              // 97      
                                        "Reserved",                              // 98      
                                        "Reserved",                              // 99      
                                        "Reserved",                              // 9A      
                                        "Reserved",                              // 9B      
                                        "Reserved",                              // 9C      
                                        "Reserved",                              // 9D      
                                        "Reserved",                              // 9E      
                                        "Reserved",                              // 9F      
                                        "Reserved",                              // A0      
                                        "Reserved",                              // A1      
                                        "Reserved",                              // A2      
                                        "Reserved",                              // A3      
                                        "Reserved",                              // A4      
                                        "Reserved",                              // A5      
                                        "Reserved",                              // A6      
                                        "Reserved",                              // A7      
                                        "Reserved",                              // A8      
                                        "Reserved",                              // A9      
                                        "Reserved",                              // AA      
                                        "Reserved",                              // AB      
                                        "Reserved",                              // AC      
                                        "Reserved",                              // AD      
                                        "Reserved",                              // AE      
                                        "Reserved",                              // AF      
                                        "Reserved",                              // B0      
                                        "Reserved",                              // B1      
                                        "Reserved",                              // B2      
                                        "Reserved",                              // B3      
                                        "Reserved",                              // B4      
                                        "Reserved",                              // B5      
                                        "Reserved",                              // B6      
                                        "Reserved",                              // B7      
                                        "Reserved",                              // B8      
                                        "Reserved",                              // B9      
                                        "Reserved",                              // BA      
                                        "Reserved",                              // BB      
                                        "Reserved",                              // BC      
                                        "Reserved",                              // BD      
                                        "Reserved",                              // BE      
                                        "Reserved",                              // BF      
                                        "Reserved",                              // C0      
                                        "Reserved",                              // C1      
                                        "Reserved",                              // C2      
                                        "Reserved",                              // C3      
                                        "Reserved",                              // C4      
                                        "Reserved",                              // C5      
                                        "Reserved",                              // C6      
                                        "Reserved",                              // C7      
                                        "Reserved",                              // C8      
                                        "Reserved",                              // C9      
                                        "Reserved",                              // CA      
                                        "Reserved",                              // CB      
                                        "Reserved",                              // CC      
                                        "Reserved",                              // CD      
                                        "Reserved",                              // CE      
                                        "Reserved",                              // CF      
                                        "Reserved",                              // D0      
                                        "Reserved",                              // D1      
                                        "Reserved",                              // D2      
                                        "Reserved",                              // D3      
                                        "Reserved",                              // D4      
                                        "Reserved",                              // D5      
                                        "Reserved",                              // D6      
                                        "Reserved",                              // D7      
                                        "Reserved",                              // D8      
                                        "Reserved",                              // D9      
                                        "Reserved",                              // DA      
                                        "Reserved",                              // DB      
                                        "Reserved",                              // DC      
                                        "Reserved",                              // DD      
                                        "Reserved",                              // DE      
                                        "Reserved",                              // DF      
                                        "Manufacturer_Specific",                 // E0      
                                        "Manufacturer_Specific",                 // E1      
                                        "Manufacturer_Specific",                 // E2      
                                        "Manufacturer_Specific",                 // E3      
                                        "Manufacturer_Specific",                 // E4      
                                        "Manufacturer_Specific",                 // E5      
                                        "Manufacturer_Specific",                 // E6      
                                        "Manufacturer_Specific",                 // E7      
                                        "Manufacturer_Specific",                 // E8      
                                        "Manufacturer_Specific",                 // E9      
                                        "Manufacturer_Specific",                 // EA      
                                        "Manufacturer_Specific",                 // EB      
                                        "Manufacturer_Specific",                 // EC      
                                        "Manufacturer_Specific",                 // ED      
                                        "Manufacturer_Specific",                 // EE      
                                        "Manufacturer_Specific",                 // EF      
                                        "Manufacturer_Specific",                 // F0      
                                        "Manufacturer_Specific",                 // F1      
                                        "Manufacturer_Specific",                 // F2      
                                        "Manufacturer_Specific",                 // F3      
                                        "Manufacturer_Specific",                 // F4      
                                        "Manufacturer_Specific",                 // F5      
                                        "Manufacturer_Specific",                 // F6      
                                        "Manufacturer_Specific",                 // F7      
                                        "Manufacturer_Specific",                 // F8      
                                        "Manufacturer_Specific",                 // F9      
                                        "Manufacturer_Specific",                 // FA      
                                        "Manufacturer_Specific",                 // FB      
                                        "Manufacturer_Specific",                 // FC      
                                        "Manufacturer_Specific",                 // FD      
                                        "Manufacturer_Specific",                 // FE      
                                        "Empty"                                  // FF      
                                        };                                       
}                                                                                
